// Circuit Racer — フルスケール実寸サーキット周回  [競技 / フルスケール]  by Fable 5
// ★領域=フルスケール・レース / コース=競技サーキット (フルスケール)★ (車輪エンコーダは不要)
//
// 実車スケール(2.6m・~350km/h)の実寸サーキット(1周~1.9km・道幅28m)を、前方3センサー
// だけで周回するレースプログラム。卓上と同じ「広い方へ操舵+前方の空きで加速」の土台に、
// フルスケール特有の2点を足すのが肝:
//   (1) 先読みブレーキ: フルスケールは速度が高くブレーキが相対的に弱い(~96m/s から停止に~115m)。
//       前方距離 C が「速く縮む」=高速でコーナーに接近、と見たら BRAKE で荷重を移して減速する。
//       (この見通しのため ToF レンジは実車レーダ相当の 150m に拡張されている=領域メタ)
//   (2) 速度を実寸に合わせて抑える: フルスケールでは pwm が実速度に効く。卓上の 255 連発は
//       コーナーで破綻するので、直線 TOP=140・コーナー TCAP=110 と低めに置く(出力律速+空力で
//       到達速度は pwm 比そのままにはならない)。
//   (3) ★視野コーン(25°)対応で再チューン★ 距離センサーは「太さゼロの直線レイ」でなく VL53L0X 相当の
//       25°視野コーンの「扇内最近」を返す(#27・Stage AM)。この実寸コースでは中央 C の読みが直線レイ
//       時代の約半分になる(扇が近いコーナー内側を先に捉えるため。実測 cone/thin≈48%)。そこで判定距離を
//       約半分へ下げた(D_OPEN 66→33m・D_MID 44→22m・D_TURN 32→16m・BIAS 4→2m)。旧値のままだと
//       「常に壁が近い」と誤認して早すぎるブレーキ/操舵でラインを失い巻き込む(実測: 61→160秒・スピン)。
//       教訓: 理想化(直線レイ)に合わせた較正は、センサーを実機(コーン)に近づけた瞬間にズレる——
//       現実に忠実にするほど、プログラム側も実機の見え方へ合わせ直す(=実機に載せ替える時と同じ作業)。
//   (4) ★精密動力学 v2 対応=全舵デューティ変調★ 走行エンジンが v2(4輪 two-track・忠実な荷重移動)に
//       変わると、3値ステアの「全舵」は この大R コーナー(直線×4+大きな角丸)には切りすぎになる。全舵を
//       当てっぱなしにすると 後輪の横グリップを破ってオーバーステア→スピン(β→180°)する。旧エンジンは
//       荷重移動が穏やかで見えなかったが、v2 は実車どおり顕在化する。対策=舵を「脈打たせる」:SPER ループ
//       のうち SDUTY 回だけ実際に舵を当て、残りは CENTER に戻す(=実効的に舵角を半分に薄める=大R に
//       ちょうど合った旋回)。あわせて旋回中の上限 TCAP を 110→78 に下げる(v2 のコーナー限界速度は低い)。
//       教訓: 操舵の"強さ"は連続量。3値しか無くても「当てる割合(デューティ)」で実効舵角を作れる——
//       センサーだけでなくエンジン(物理)が変わっても、プログラムは新しい挙動へ合わせ直す(AN と同じ作業)。
//
// ★車種の物理レッスン★ このコードは「ノーマル FF」で安定して周回する。同じコードを
//   ノーマル FR / 4WD で走らせると、最初のコーナーで巻き込んでスピンする(オーバーステア)。
//   実車スケールでは弱アンダーの FF が一番素直=「曲がる車ほど限界で危ない」を体感できる。
//
// 距離は RC_read() を使う(範囲外で -3 を返す=「遠く開けている」が符号で明確に分かる。
//   sensorN.readRangeSingleMillimeters() の範囲外値 8190 は『8.19m の壁』と区別できないため避ける)。
int TOP=140, MID=110, SLOW=82, TCAP=78;             // 速度(pwm): 直線/中速/コーナー/旋回中の上限(TCAP は v2 で 110→78)
int D_OPEN=33000, D_MID=22000, D_TURN=16000;        // 判定距離[mm](実寸 m×1000。33000=33m。視野コーン対応で直線レイ時代の半分)
int CLOSE=1600, BRK=240, BIAS=2000;                 // 接近検知[mm/loop] / ブレーキpwm / センタリング閾[mm](コーン対応で半分)
int SDUTY=1, SPER=2;    // 全舵デューティ: SPER ループのうち SDUTY だけ実際に舵を当てる(残りは CENTER)=実効舵角を薄める(v2)
int CONF=150000;     // 信頼区間[mm]: >CONF/範囲外(-3)=「遠い/開放」。本フルスケールは実車レーダ相当の
// 150m レンジで設計しているので信頼区間もレーダ地平(150m)とする。実短距離 ToF の地面拘束は ~5m
// (=250mm×領域スケール20)ゆえ、実機/自機ではここを下げて要調整(下げるほど遠くの壁を見ず反応が遅れる)。
int prevC; int started; int sc;

void setup() { RC_setup(); prevC = 0; started = 0; sc = 0; }

void loop() {
  int L = RC_read(LEFT);
  int C = RC_read(CENTER);
  int R = RC_read(RIGHT);
  if (L < 0 || L > CONF) L = 99000;   // 範囲外(-3)=遠く開けている → 大きな値に正規化
  if (C < 0 || C > CONF) C = 99000;
  if (R < 0 || R > CONF) R = 99000;
  int dC = 0;
  if (started == 1) dC = prevC - C;   // dC>0 = 前方が縮む = コーナー/壁へ接近
  prevC = C; started = 1;

  // 操舵の向きを決める: 前が詰まれば広い方へ、緩い区間は近い壁から離れてセンタリング
  int turning = 1; int dir = CENTER;
  if (C < D_TURN) { if (L > R) dir = LEFT; else dir = RIGHT; }
  else if (L - R > BIAS) dir = LEFT;
  else if (R - L > BIAS) dir = RIGHT;
  else { dir = CENTER; turning = 0; }
  // ★v2 の全舵デューティ変調★ 舵を脈打たせて実効舵角を薄める(=大R に合った旋回。詳細は上のねらい(4))。
  int phase = sc % SPER; sc = sc + 1;
  if (turning == 1 && phase < SDUTY) RC_steer(dir); else RC_steer(CENTER);

  // 速度: 前方が開けているほど速く。旋回中は上限を抑え巻き込みを防ぐ
  int pwm = SLOW;
  if (C > D_OPEN) pwm = TOP;
  else if (C > D_MID) pwm = MID;
  if (turning == 1 && pwm > TCAP) pwm = TCAP;

  // ★先読みブレーキ★ 前方が速く縮んでいるなら(高速でコーナー接近)、突っ込む前に減速する
  if (dC > CLOSE && C < D_OPEN) RC_drive(BRAKE, BRK);
  else RC_drive(FORWARD, pwm);
}
