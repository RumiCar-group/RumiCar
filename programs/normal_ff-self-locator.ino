# Self-Locator — ToF×3 + 車輪エンコーダで「今コースのどこにいるか」を1次元ヒストグラムフィルタで推定する  [競技 / フルスケール・Python・要エンコーダ]  by Opus 4.8
# ★領域=フルスケール / コース=競技サーキット / 車=ノーマルFF / 車輪エンコーダ(任意)ON★
# 実車の自己位置推定を ToF×3+エンコーダだけで再現する研究/競技サンプル。絶対位置・方位は与えられない(D-1)。
#   1周目(試走): 反応走行しながら「スタートからの距離」を目盛りに、各地点の前方/左右の壁距離を
#                「指紋(fingerprint)」として記録する。スタート地点の壁パターンも覚える。
#   周回検出=loop closure: 十分走って方位が一周ぶん回り、かつ「今の壁パターンが覚えたスタートの
#                パターンに戻った」ら1周完了とみなす(実車のループ閉じ込み)。1周の距離 LAPLEN が確定。
#   2周目以降(本番): 前方3センサーの今の値を各目盛りの指紋と照合し、どの目盛り(=弧長)に居るかを
#                確率分布(ヒストグラム)で追跡する。予測=エンコーダで分布を前へ、観測=指紋残差
#                k=1/(1+(err/σ)^2) で重み付け→正規化。推定 ŝ=分布のピーク近傍の加重平均・信頼度=ピーク比。
#   他車分離(残差ゲーティング): 「壁測定は位置に・地図差分は他車に」。前方/側方が覚えた壁より有意に
#                近ければ そこに他車(その channel は位置更新から外す=他車が居ても位置は発散しない)。
# ★毎周おなじ反応ラインで走る(先読みで線を変えない)=指紋が周回間で再現し照合が効く。速さより
#   「自分がどこに居るか正確に知る」ことを見せるサンプル(先読み最速化は Apex Strategist へ)。★
# ★D-1: 学習側は ToF×3 + 任意エンコーダのみ。位置は自前計測の学習物(コースデータは渡されない)。★
# 走行(反応)定数
CONF=150000
D_TURN=16000
D_MID=22000
D_OPEN=33000
BIAS=2000
TOP=91
MID=72
SLOW=53
TCAP=58
CLOSE=1600
BRK=240
# 自己位置(loop closure)定数
BLF=380
NF=160
LAP_MIN_S=30000
LAP_HDG=6300
CLOSURE=4000
MINWAIT=6
# 観測カーネルσ² (残差の効き。σ大=甘い・小=多峰へ発散)
SC2=64000000
SS2=100000000
CARGAP2=9000
DT=0.05
WIN=7
GAIN=0.05
# 指紋(fine バケツ)・ヒストグラム
fpC=[99000, 99000, 99000, 99000, 99000, 99000, 99000, 99000, 99000, 99000, 99000, 99000, 99000,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 99000, 99000]
fpL=[99000, 99000, 99000, 99000, 99000, 99000, 99000, 99000, 99000, 99000, 99000, 99000, 99000,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 99000, 99000]
fpR=[99000, 99000, 99000, 99000, 99000, 99000, 99000, 99000, 99000, 99000, 99000, 99000, 99000,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 99000, 99000]
fpN=[0, 0, 0, 0, 0, 0, 0, 0, 0, 0, 0, 0, 0,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 0, 0]
w=[0, 0, 0, 0, 0, 0, 0, 0, 0, 0, 0, 0, 0,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 0, 0]
wt=[0, 0, 0, 0, 0, 0, 0, 0, 0, 0, 0, 0, 0,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 0, 0]
LAPLEN=0
LAPBF=0
lp=0
s=0
sl=0
hdg=0
prevC=0
started=0
sc=0
fs0C=0
fs0L=0
fs0R=0
lstart=0
armed=0
mmin=999999
mminSl=0
sinceMin=0
mdbg=0
estb=0
ests=0
conf=0
carF=0
carL=0
carR=0
pe=0
betaEst=0
betaN=0

def setup():
    global LAPLEN, LAPBF, lp, s, sl, hdg, prevC, started, sc, fs0C, fs0L, fs0R, lstart, armed, mmin, mminSl, sinceMin, mdbg, estb, ests, conf, carF, carL, carR, pe, betaEst, betaN
    RC_setup()
    LAPLEN=0
    LAPBF=0
    lp=0
    s=0
    sl=0
    hdg=0
    prevC=0
    started=0
    sc=0
    fs0C=0
    fs0L=0
    fs0R=0
    lstart=0
    armed=0
    mmin=999999
    mminSl=0
    sinceMin=0
    mdbg=0
    estb=0
    ests=0
    conf=0
    carF=0
    carL=0
    carR=0
    pe=0
    betaEst=0
    betaN=0
    for i in range(NF):
        fpC[i]=99000
        fpL[i]=99000
        fpR[i]=99000
        fpN[i]=0
        w[i]=0
        wt[i]=0

def loop():
    global LAPLEN, LAPBF, lp, s, sl, hdg, prevC, started, sc, fs0C, fs0L, fs0R, lstart, armed, mmin, mminSl, sinceMin, mdbg, estb, ests, conf, carF, carL, carR, pe, betaEst, betaN
    v=RC_wheel_speed(REAR)
    if v<0:
        v=0
    s=s+v
    sl=sl+v
    L=RC_read(LEFT)
    C=RC_read(CENTER)
    R=RC_read(RIGHT)
    if L<0 or L>CONF:
        L=99000
    if C<0 or C>CONF:
        C=99000
    if R<0 or R>CONF:
        R=99000
    dC=0
    if started==1:
        dC=prevC-C
    prevC=C
    started=1
    # ── 反応走行 (毎周同一ライン=指紋再現性の源) ──
    turning=1
    st=0
    dir=CENTER
    if C<D_TURN:
        if L>R:
            dir=LEFT
            st=1
        else:
            dir=RIGHT
            st=0-1
    elif L-R>BIAS:
        dir=LEFT
        st=1
    elif R-L>BIAS:
        dir=RIGHT
        st=0-1
    else:
        dir=CENTER
        turning=0
    sc=sc+1
    if turning==1 and (sc%2)<1:
        RC_steer(dir)
    else:
        RC_steer(CENTER)
    hdg=hdg+st*v
    pwm=SLOW
    if C>D_OPEN:
        pwm=TOP
    elif C>D_MID:
        pwm=MID
    if turning==1 and pwm>TCAP:
        pwm=TCAP
    if dC>CLOSE and C<D_OPEN:
        RC_drive(BRAKE,BRK)
    else:
        RC_drive(FORWARD,pwm)
    # ── 指紋づくり (fine バケツ・lap-local 弧長 sl 目盛り・初回入場時に1回) ──
    bf=sl//BLF
    if bf<0:
        bf=0
    if bf>=NF:
        bf=NF-1
    if lstart==0:
        fs0C=C
        fs0L=L
        fs0R=R
        lstart=1
    if lp==0:
        if fpN[bf]==0:
            fpC[bf]=C
            fpL[bf]=L
            fpR[bf]=R
            fpN[bf]=1
    # ── loop closure (局所最小): 方位が一周ぶん回ったら武装し、スタート指紋との差 match が「最小」に
    #    なった点=真のスタート(=φ1.0)で1周確定。単なる閾値割れは対称ゴーストで早発火するので最小追跡。──
    match=abs(C-fs0C)+abs(L-fs0L)+abs(R-fs0R)
    mdbg=match
    # 武装 = 方位が一周ぶん回った。以後 スタート壁パターンとの差 match が「局所最小」になった点=スタート
    #   復帰 で1周を確定 (単なる閾値割れは対称ゴーストで早発火するので最小追跡)。実測: 周回内の相対位置は
    #   in-sample 0.30bin と高精度。絶対原点は閉じ込み点の ToF ノイズで周ごとに ~2.5bin ブレる (held-out
    #   2.59bin) =この差が loop closure の原点精度限界 (docs/stage_ao/localize_result.md)。
    if sl>LAP_MIN_S and (hdg>LAP_HDG or hdg<0-LAP_HDG):
        armed=1
    if armed==1:
        if match<mmin:
            mmin=match
            mminSl=sl
            sinceMin=0
        else:
            sinceMin=sinceMin+1
        # 最小を過ぎ (match が再上昇) かつ最小が十分小さいなら発火。LAPLEN=mminSl (真の1周長)。
        if sinceMin>MINWAIT and mmin<CLOSURE:
            if lp==0:
                LAPLEN=mminSl
                LAPBF=mminSl//BLF
                if LAPBF<1:
                    LAPBF=1
                if LAPBF>=NF:
                    LAPBF=NF-1
                i=0
                while i<LAPBF:
                    if fpN[i]==0:
                        pj=i-1
                        if pj<0:
                            pj=LAPBF-1
                        fpC[i]=fpC[pj]
                        fpL[i]=fpL[pj]
                        fpR[i]=fpR[pj]
                    w[i]=0.0
                    i=i+1
                lp=1
                Serial.println("localizer ready: " + LAPBF + " bins (loop closed)")
            # 再アンカー: sl を「最小からの走行ぶん」へ (=真スタートから今までの距離)。信念もそこへ。
            sl=sl-mminSl
            bb=sl//BLF
            if bb<0:
                bb=0
            if bb>=LAPBF:
                bb=LAPBF-1
            estb=bb
            i=0
            while i<LAPBF:
                if i==bb:
                    w[i]=1.0
                else:
                    w[i]=0.0
                i=i+1
            armed=0
            mmin=999999
            sinceMin=0
    # ============ 自己位置推定 (lp==1・ヒストグラムフィルタ) ============
    if lp==1:
        # 予測: エンコーダで前進 dsb ビン (小数)。前方移流 + 小拡散。
        dsb=v/BLF
        if dsb<0:
            dsb=0
        if dsb>0.9:
            dsb=0.9
        i=0
        while i<LAPBF:
            wt[i]=w[i]
            i=i+1
        i=0
        while i<LAPBF:
            jm=i-1
            if jm<0:
                jm=LAPBF-1
            jp=i+1
            if jp>=LAPBF:
                jp=0
            w[i]=(1-dsb)*wt[i]+dsb*wt[jm]
            w[i]=0.96*w[i]+0.02*wt[jm]+0.02*wt[jp]
            i=i+1
        # 他車ゲーティング (現ベスト bin の指紋より有意に近ければ その channel は位置更新から除外)
        cb=floor(estb)
        if cb<0:
            cb=0
        if cb>=LAPBF:
            cb=LAPBF-1
        useC=1
        useL=1
        useR=1
        if C<fpC[cb]-CARGAP2:
            useC=0
        if L<fpL[cb]-CARGAP2:
            useL=0
        if R<fpR[cb]-CARGAP2:
            useR=0
        # 観測: 指紋残差 → 有理カーネル k=1/(1+err)。ソフト適用 w*=(SOFTA+SOFTB*k) で1tick の
        #   誤マッチ(知覚エイリアシング=別地点が似て見える)では信念が飛ばず、持続証拠で徐々に収束させる。
        i=0
        while i<LAPBF:
            err=0
            if useC==1:
                d0=C-fpC[i]
                err=err+d0*d0/SC2
            if useL==1:
                d1=L-fpL[i]
                err=err+d1*d1/SS2
            if useR==1:
                d2=R-fpR[i]
                err=err+d2*d2/SS2
            kk=1/(1+err)
            w[i]=w[i]*(0.6+0.4*kk)
            i=i+1
        # 正規化 (総和ガード)
        sm=0
        i=0
        while i<LAPBF:
            sm=sm+w[i]
            i=i+1
        if sm<0.000000001:
            i=0
            while i<LAPBF:
                w[i]=1.0/LAPBF
                i=i+1
            sm=1.0
        i=0
        while i<LAPBF:
            w[i]=w[i]/sm
            i=i+1
        # 推定 ŝ = オドメトリ位置 (=lap-local 弧長 sl の bin・毎周 loop closure で再アンカー=高精度な骨格)
        #   を中心に、その ±WIN 窓内の地図照合ピークへ GAIN だけ寄せる (=有界な地図補正)。実測で ToF 照合
        #   はこの清潔コースでエンコーダに勝てない (観測は追従ノイズを足す) ため、骨格をオドメトリに固定し
        #   観測は「軽い補正＋信頼度・他車ゲーティングの源」に留める (docs/stage_ao/localize_result.md・CI-14)。
        center=sl/BLF
        if center<0:
            center=0
        if center>=LAPBF:
            center=center%LAPBF
        c0=floor(center)
        if c0<0:
            c0=0
        if c0>=LAPBF:
            c0=LAPBF-1
        pk=0
        pi=c0
        jw=0-WIN
        while jw<=WIN:
            kw=(c0+jw)%LAPBF
            if kw<0:
                kw=kw+LAPBF
            if w[kw]>pk:
                pk=w[kw]
                pi=kw
            jw=jw+1
        csum=0
        wsum=0
        jj=0-3
        while jj<=3:
            kk=(pi+jj)%LAPBF
            if kk<0:
                kk=kk+LAPBF
            csum=csum+w[kk]*jj
            wsum=wsum+w[kk]
            jj=jj+1
        off=0
        if wsum>0:
            off=csum/wsum
        estRaw=pi+off
        # 相補フィルタ: 出力=オドメトリ予測 + GAIN×(観測ピーク−予測) の円環ブレンド。オドメトリ(=予測)は
        #   滑らかで既に高精度なので主体にし、観測は「遅いドリフト補正」として少しだけ効かせる(観測ノイズを
        #   出力へ持ち込まない=正しいベイズ融合は予測のみより悪化しない)。
        diff=estRaw-center
        if diff>LAPBF/2:
            diff=diff-LAPBF
        if diff<0-LAPBF/2:
            diff=diff+LAPBF
        estb=center+GAIN*diff
        if estb<0:
            estb=estb+LAPBF
        if estb>=LAPBF:
            estb=estb-LAPBF
        ests=estb*BLF
        conf=pk
        # 他車フラグ (recall 用・driver は他車回避しないがフラグは出す)
        carF=0
        carL=0
        carR=0
        if useC==0:
            carF=1
        if useL==0:
            carL=1
        if useR==0:
            carR=1
        # (毎周の再アンカーは上の loop closure 局所最小で sl をリセット=信念もスタートへ再同期済)
        # ── β 再挑戦 (地図事前分布つき・実験): レコンライン からの横ずれ e とそのレート ──
        cbf=floor(estb)
        if cbf<0:
            cbf=0
        if cbf>=LAPBF:
            cbf=LAPBF-1
        if useL==1 and useR==1 and v>3:
            e=((fpL[cbf]-L)+(R-fpR[cbf]))/2
            de=e-pe
            pe=e
            braw=atan2(de/1000/DT,v)*57.29578
            betaEst=0.7*betaEst+0.3*braw
            betaN=betaN+1
        if (sc%10)==0:
            Serial.println("pos=bin " + round(estb) + "/" + LAPBF + " conf=" + round(conf*100) + "%")
